## Kconfig
```kconfig
mainmenu "Configuration"

config CLANG
	bool "Use Clang/LLVM to compile"
	help
	  Uses Clang/LLVM to compile the kernel

config CROSS_COMPILE
	string "GCC Cross-compiler tool prefix"
	help
	  Same as running 'make CROSS_COMPILE=prefix-' but stored for
	  default make runs in this kernel build directory.  You don't
	  need to set this unless you want the configured kernel build
	  directory to select the cross-compiler automatically.
	 depends on !CLANG

source "kernel/Kconfig"

menuconfig GENERATE_ISO
    bool "Generate a Limine iso with the kernel"
    help
      It automatically generates a image.iso file with the Limine bootloader in it.

if GENERATE_ISO

config ISO_MULTI
    bool "Generate a multi-boot iso with both UEFI and BIOS limine."
    select ISO_UEFI
    select ISO_BIOS
    help
      Enabling this creates a single Znu.iso with both UEFI and BIOS limine.

config ISO_BIOS
    bool "Generate Znu.bios.iso"
    help
      This option generates a seperate Znu.bios.iso file with only BIOS limine.

config ISO_UEFI
    bool "Generate Znu.uefi.iso"
    help
      This option generates a seperate Znu.uefi.iso file with only UEFI limine.

endif # GENERATE_ISO

source "yuki/Kconfig"

menu "Device Drivers"

source "drivers/Kconfig"

endmenu
```

## drivers/Kconfig
```kconfig
config BGA
	tristate "Enable BGA (Bochs Graphic Adapter) Support"
	help
	  Enables the Bochs Graphic Adapter to be used instead of the normal, fixed-size limine framebuffer.

config E1000
	tristate "Enable Intel PRO/1000 Network Driver"
	help
	  Enables the support for the Intel E1000 Network Adapter.

config AHCI
	tristate "Enable AHCI Driver"
	help
	  Enables the support for AHCI Drives.
```

## kernel/filters/Kconfig
```kconfig
menuconfig ZFILTER
	bool "Enable Zfilter support"
	default y

if ZFILTER

config ZFILTER_NOSRY
	bool "Enable the Nosry VM for Zfilter"
	default n

endif # ZFILTER
```
