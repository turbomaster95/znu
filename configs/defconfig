## configs/defconfig
```kconfig
CONFIG_CROSS_COMPILE="x86_64-elf-"
CONFIG_GENERATE_ISO=y
CONFIG_MAKE_UKI=y
CONFIG_FB_TEST=n
```

## kernel/Kconfig
```kconfig
config KTEST
	bool "Enable the KRTT (Kernel RunTime Testing) Framework"
	default y
	help
	  Enable the KRT Framework, which runs tests on the features which are most likely to fail on runtime.
	  For example, it runs tests on the timings, networking, etc.
```

## uki/Kconfig
```kconfig
config MAKE_UKI
	bool "Generate a UKI (Unified Kernel Image) for a UEFI Bootloader"
	help
	  This generates a .efi file which contains the limine bootloader aswell as the kernel in a single, contained package.
```
