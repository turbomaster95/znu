## configs/arm64_defconfig
```kconfig
CONFIG_CLANG=y
CONFIG_GENERATE_ISO=y
# CONFIG_ISO_MULTI is not set
# CONFIG_ISO_BIOS is not set
CONFIG_ISO_UEFI=y
CONFIG_MAKE_UKI=n
CONFIG_SMP=y
CONFIG_MODULES=y
# CONFIG_KTEST is not set
# CONFIG_ZFILTER is not set
# CONFIG_BGA is not set
# CONFIG_E1000 is not set
# CONFIG_AHCI is not set
```

## lib/Kconfig
```kconfig
config DEFAULT_LOGLEVEL
        int "Default message log level (0-4)"
        range 0 4
        default 2
        help
          Default priority level for Znu logging functions.

          Depending on this value, each logging function
          (p_error, p_warn, p_info, p_debug, p_trace) outputs
          log messages to the console, or does nothing.

          LOG_LEVEL  p_error  p_warn  p_info  p_debug  p_trace
              0        o        x       x        x        x
              1        o        o       x        x        x
              2        o        o       o        x        x
              3        o        o       o        o        x
              4        o        o       o        o        o

          Here:
            o: Output log messages
            x: Do nothing

          This value can be overridden at build time using
          the LOG_LEVEL make variable.
```
